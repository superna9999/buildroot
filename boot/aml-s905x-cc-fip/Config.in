## boot/aml-s905x-cc-fip/Config.in
```kconfig
config BR2_TARGET_AML_S905X_CC_FIP
	bool "aml-s905x-cc fip"
	depends on BR2_aarch64
	help
	  Amlogic FIP boot firmwares for AML-S905X-CC
```

## configs/aml-s905x-cc_defconfig
```kconfig
# Architecture
BR2_aarch64=y

# System
BR2_TARGET_GENERIC_HOSTNAME="aml-s905x-cc"
BR2_TARGET_ROOTFS_EXT2=y
BR2_TARGET_ROOTFS_EXT2_4=y
BR2_ROOTFS_POST_BUILD_SCRIPT="board/librecomputer/aml-s905x-cc/post-build.sh"
BR2_ROOTFS_POST_IMAGE_SCRIPT="board/librecomputer/aml-s905x-cc/post-image.sh"

# Kernel
BR2_LINUX_KERNEL=y
BR2_LINUX_KERNEL_USE_ARCH_DEFAULT_CONFIG=y
BR2_LINUX_KERNEL_DTS_SUPPORT=y
BR2_LINUX_KERNEL_BUILD_DEFAULT_DTS=y
BR2_LINUX_KERNEL_USE_INTREE_DTS=y
BR2_LINUX_KERNEL_INTREE_DTS_NAME="amlogic/meson-gxl-s905x-libretech-cc"
BR2_LINUX_KERNEL_IMAGE=y
BR2_LINUX_KERNEL_INSTALL_TARGET=y

# U-Boot
BR2_TARGET_UBOOT=y
BR2_TARGET_UBOOT_BOARDNAME="libretech-cc"
BR2_TARGET_UBOOT_BOARD_DEFCONFIG="libretech-cc"
BR2_TARGET_AML_S905X_CC_FIP=y

# Required tools to create the SD image
BR2_PACKAGE_HOST_DOSFSTOOLS=y
BR2_PACKAGE_HOST_GENIMAGE=y
BR2_PACKAGE_HOST_MTOOLS=y
```
